/* -------------------------------------------------------------------------------------------------------------------------- */
/**/
/* -------------------------------------------------------------------------------------------------------------------------- */

/* NAME: KernelLinker.ld  */

/* -------------------------------------------------------------------------------------------------------------------------- */
/**/
/* -------------------------------------------------------------------------------------------------------------------------- */

ENTRY(_start)

SECTIONS
{
    . = 0x80000;

    .Bootstrap : { KEEP(*(.Bootstrap)) }

    .text : { *(.text*) }
    .rodata : { *(.rodata*) }
    .data : { *(.data*) }

    . = ALIGN(8);

    StartOfBSS = .;

    .bss : { *(.bss*) }

    EndOfBSS = .;
    
    SizeOfBSS = EndOfBSS - StartOfBSS;
    ClearBlockCountBSS = SizeOfBSS / 8; /* Must Be Same As  */

    HeapStart = .;
}